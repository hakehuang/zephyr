## subsys/audio/machine/Kconfig
```kconfig
# Audio configuration options

# Copyright (c) 2020 NXP Semiconductor INC.
# SPDX-License-Identifier: Apache-2.0

menuconfig AUDIO_PM
	bool "SOC audio power manager"
	default n
	help
	  This option is to enable Power Managerment of audio

if AUDIO_PM

config NXP_RT_AUDIO_SYS
	bool
	help
	  This option is to use NXP RT audio

endif # AUDIO_PM
```

## subsys/fb/Kconfig
```kconfig
# Kconfig - frame buffer configuration options

#
# Copyright (c) 2018 Phytec Messtechnik GmbH
#
# SPDX-License-Identifier: Apache-2.0
#

menuconfig CHARACTER_FRAMEBUFFER
	bool "Character framebuffer for dot matrix displays"
	help
	  Character framebuffer for dot matrix displays.

if CHARACTER_FRAMEBUFFER

config CHARACTER_FRAMEBUFFER_USE_DEFAULT_FONTS
	bool "Use default fonts"
	default y if SSD1673
	default y if SSD1306
	help
	  Use default fonts.

config CHARACTER_FRAMEBUFFER_USE_LINUX_FONTS
	bool "Use Linux 8x8 fonts"
	default y if DISPLAY_MCUX_ELCDIF
	help
	  Use default fonts.

config CHARACTER_FRAMEBUFFER_SHELL
	bool "Character Framebuffer shell"
	depends on SHELL
	help
	  Activate shell module that provides Framebuffer commands to the
	  console.

if CHARACTER_FRAMEBUFFER_SHELL
	config CHARACTER_FRAMEBUFFER_SHELL_DRIVER_NAME
	string
	default "SSD1673" if SSD1673
	default "SSD1306" if SSD1306
	default "ELCDIF_1" if DISPLAY_MCUX_ELCDIF
	help
	  Character Framebuffer Display Driver Name

endif

module = CFB
module-str = cfb
source "subsys/logging/Kconfig.template.log_config"

endif # CHARACTER_FRAMEBUFFER
```

## subsys/usb/device/class/gs_usb/Kconfig
```kconfig
# Copyright (c) 2024 Alexander Kozhinov
# SPDX-License-Identifier: Apache-2.0

module = GS_USB
module-str = gs_usb

menuconfig USB_GS_USB_CLASS
	bool "CAN driver for Geschwister Schneider USB/CAN devices"
	depends on CAN
	select EXPERIMENTAL
	help
	  CAN driver for Geschwister Schneider USB/CAN devices

if USB_GS_USB_CLASS

config GS_USB_NUM_CAN_CHANNEL
	int
	default 1
	help
	  Number of CAN channels

config GS_USB_SW_VERSION
	int
	default 2
	help
	  Software version

config GS_USB_HW_VERSION
	int
	default 1
	help
	  Hardware version

config GS_USB_TERM_PIN
	bool "CAN bus termination pin control"
	default n

config GS_USB_DEVICE_LOG_LEVEL
	int
	default 0

config GS_USB_CAN_TX_MSG_QUEUE_SIZE
	int "CAN to USB inernal TX data buffer size"
	default 16

config GS_USB_CAN_RX_MSG_QUEUE_SIZE
	int "CAN to USB inernal RX data buffer size"
	default 16

source "subsys/logging/Kconfig.template.log_config"

endif  # USB_GS_USB_CLASS
```

## tests/audio/audio_player/testcase.yaml
```yaml
tests:
  audio_player:
    tags: audio
    min_ram: 32
#    platform_whitelist: mimxrt1060_evk
```

## tests/drivers/i2s/i2s_api/boards/mimxrt595_evk_cm33.conf
```kconfig
#
# Copyright (c) 2023, NXP
#
# SPDX-License-Identifier: Apache-2.0
#

CONFIG_I2S_TEST_SEPARATE_DEVICES=y
CONFIG_DMA=y
CONFIG_I2S_MCUX_FLEXCOMM=y
CONFIG_I3C=y
CONFIG_HEAP_MEM_POOL_SIZE=1024
CONFIG_AUDIO=y
CONFIG_AUDIO_CODEC=y
CONFIG_AUDIO_WM8904=y
```

## tests/drivers/i2s/i2s_speed/boards/mimxrt1060_evk.conf
```kconfig
CONFIG_DMA=y
CONFIG_I2S_MCUX_SAI=y
CONFIG_I2S_0=y
CONFIG_I2C=y
CONFIG_PINMUX_MCUX_RT=y
CONFIG_PINMUX=y
CONFIG_HEAP_MEM_POOL_SIZE=1024
CONFIG_AUDIO=y
CONFIG_AUDIO_CODEC=y
CONFIG_AUDIO_WM8960=y
CONFIG_I2S_TEST_NO_LOOPBACK=y
CONFIG_MASTER_CLK=y
```

## tests/drivers/spi/spi_dma_loopback/boards/frdm_k64f.conf
```kconfig
#
# Copyright (c) 2018, NXP
#
# SPDX-License-Identifier: Apache-2.0
#

CONFIG_SPI_LOOPBACK_DRV_NAME="SPI_0"
CONFIG_DMA=y
CONFIG_DSPI_MCUX_EDMA=y
CONFIG_MCUX_DSPI_BUFFER_SIZE=144
CONFIG_SPI_LOOPBACK_FAST_FREQ=1000000
```

## tests/net/ptp/clock_hw/testcase.yaml
```yaml
common:
  depends_on: netif
  # We can only run this in platforms that support PTP clock
  filter: CONFIG_PTP_CLOCK_MCUX
tests:
  net.ptp.clock:
    min_ram: 32
    tags: net ptp gptp userspace
```
