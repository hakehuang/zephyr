## boards/st/stm32f030_disco/Kconfig.stm32f030_disco
```kconfig
# Copyright (c) 2025 <hakehuang@gmail.com>
# SPDX-License-Identifier: Apache-2.0

config BOARD_STM32F030_DISCO
	select SOC_STM32F030X4
```

## boards/st/stm32f030_disco/board.yml
```yaml
board:
  name: stm32f030_disco
  full_name: STM32F030x4 Discovery
  vendor: st
  socs:
    - name: stm32f030x4
```

## drivers/audio/Kconfig.dmic_mcux
```kconfig
# Copyright 2023 NXP
# SPDX-License-Identifier: Apache-2.0

config AUDIO_DMIC_MCUX
	bool "DMIC driver for MCUX"
	default y
	depends on DT_HAS_NXP_MCUX_DMIC_ENABLED
	select MCUX_DMIC
	select DMA
	help
	  Enable support for DMIC on NXP MCUX SoC's
```

## drivers/audio/Kconfig.wm8960
```kconfig
# Copyright (c) 2021, NXP
# SPDX-License-Identifier: Apache-2.0

config AUDIO_WM8960
	bool "use wm8960"
	select I2C
	help
	  This option is to use the WM8960 codec

if AUDIO_WM8960

config AUDIO_LOOP_DIVIDER
	int "PLL loop divider"
	default 32
	help
	  PLL loop divider. Valid range for DIV_SELECT divider value: 27~54

config AUDIO_POST_DIVIDER
	int "Divider after the PLL"
	default 1
	help
	  Divider after the PLL, should only be 1, 2, 4, 8, 16

config AUDIO_NUMERATOR
	int "numerator of fractional loop divider."
	default 77
	help
	  30 bit numerator of fractional loop divider.

config AUDIO_DENOMINATOR
	int "denominator"
	default 100
	help
	  30 bit denominator of fractional loop divider

config WM8960_LEFT_INPUT
	int "left input"
	default 0
	help
	  WM8960 left input 0 - 5

config WM8960_RIGHT_INPUT
	int "right input"
	default 2
	help
	  WM8960 right input 0 - 5

config WM8960_ENABLE_SPEAKER
	bool "enable speaker"
	help
	  WM8960 enable speaker

endif # AUDIO_WM8960
```

## drivers/i2s/Kconfig.imx_rt
```kconfig
# STM32 I2S driver configuration options

# Copyright (c) 2018 STMicroelectronics
# SPDX-License-Identifier: Apache-2.0

menuconfig I2S_IMX_RT
	bool "NXP imx RT I2S controller driver"
	depends on SOC_SERIES_IMX_RT && DMA_IMX_RT && PINMUX_MCUX_GPR
	help
	  Enable I2S support on the I.MX family of processors.
	  (Tested on the imxrt10xx series)

if I2S_IMX_RT

config IMX_SAI
	bool "use SAI driver"
	default y
	help
	  use SAI driver

config IMX_SAI_DMA
	bool "use SAI edma driver"
	default y
	help
	  use SAI edma driver

config I2S_BUFFER_QUEUE_COUNT
	int "default I2S buffer queue counts"
	default 2
	help
	  default i2s buffer queue counts

config I2S_0
	bool "I2S port 1"
	default y
	help
	  Enable I2S controller SAI1.

config I2S_0_TX_DMA_SLOT
	int "default I2S TX DMA SLOT"
	default 0
	depends on I2S_0
	help
	  default i2s1 dma tx slot

config I2S_0_RX_DMA_SLOT
	int "default I2S RX DMA SLOT"
	default 1
	depends on I2S_0
	help
	  default i2s1 dma rx slot

config I2S_1
	bool "I2S port 2"
	help
	  Enable I2S controller SAI2.


config I2S_1_TX_DMA_SLOT
	int "default I2S TX DMA SLOT"
	default 2
	depends on I2S_1
	help
	  default i2s2 dma tx slot

config I2S_1_RX_DMA_SLOT
	int "default I2S RX DMA SLOT"
	default 3
	depends on I2S_1
	help
	  default i2s2 dma rx slot

config I2S_2
	bool "I2S port 3"
	help
	  Enable I2S2 controller SAI3.


config I2S_2_TX_DMA_SLOT
	int "default I2S TX DMA SLOT"
	default 4
	depends on I2S_2
	help
	  default i2s3 dma tx slot

config I2S_2_RX_DMA_SLOT
	int "default I2S RX DMA SLOT"
	default 5
	depends on I2S_2
	help
	  default i2s2 dma rx slot

endif # I2S_IMX_RT
```

## drivers/i2s/Kconfig.mcux
```kconfig
# MCUX I2S driver configuration options

# Copyright (c) 2020, NXP
# SPDX-License-Identifier: Apache-2.0

menuconfig I2S_MCUX_SAI
	bool "NXP MCUX I2S controller driver"
	depends on SOC_SERIES_IMX_RT
	help
	  Enable I2S support on the I.MX family of processors.

if I2S_MCUX_SAI

config I2S_0
	bool "I2S port 0"
	help
	  Enable I2S controller port 0.

config I2S_1
	bool "I2S port 1"
	help
	  Enable I2S controller port 1.

config I2S_2
	bool "I2S port 2"
	help
	  Enable I2S controller port 2.


config I2S_ENABLE_EDMA
	bool "ENABLE EDMA for I2S driver"
	default y
	depends on HAS_MCUX_I2S && HAS_MCUX_EDMA
	help
	  Enable the MCUX I2S driver.

config I2S_RX_BLOCK_COUNT
	int "RX queue length"
	default 4

config I2S_TX_BLOCK_COUNT
	int "TX queue length"
	default 4

if I2S_ENABLE_EDMA

config I2S_EDMA_BURSE_SIZE
	int "DMA BURSE SIZE"
	default 2
	help
	  DMA burse size in byte.

endif # I2S_ENABLE_EDMA

endif # I2S_MCUX_SAI
```

## drivers/pinmux/Kconfig.imx
```kconfig
# MCUXpresso SDK pinmux

# Copyright (c) 2016, Freescale Semiconductor, Inc.
# SPDX-License-Identifier: Apache-2.0

menuconfig PINMUX_IMX
	bool "i.MX.RT pinmux driver"
	depends on SOC_SERIES_IMX_RT
	help
	  Enable the i.MX.RT pinmux driver.

if PINMUX_IMX

config PINMUX_MCUX_GPR
	bool "General Purpose Register"
	default y
	help
	  Enable General Purpose Register.

endif # PINMUX_MCUX
```

## drivers/pinmux/Kconfig.mcux_rt
```kconfig
# MCUXpresso SDK pinmux for RT

# Copyright (c) 2020, NXP
# SPDX-License-Identifier: Apache-2.0

menuconfig PINMUX_MCUX_RT
	bool "MCUX RT pinmux driver"
	depends on SOC_SERIES_IMX_RT
	help
	  Enable the MCUX RT pinmux driver.

if PINMUX_MCUX_RT

config PINMUX_MCUX_RT_GPR_NAME
	string "Pinmux GPR driver name"
	default "IOMUX_GPR"

endif # PINMUX_MCUX_RT
```

## dts/bindings/audio/nxp,mcux-dmic-channel.yaml
```yaml
# Copyright 2023 NXP
# SPDX-License-Identifier: Apache-2.0

description: NXP DMIC CHANNEL

compatible: "nxp,mcux-dmic-channel"

include: [base.yaml]

properties:
  reg:
    required: true

  dmas:
    required: true

  use2fs:
    required: false
    type: boolean

  hwvad:
    required: false
    type: boolean
```

## dts/bindings/audio/nxp,mcux-dmic.yaml
```yaml
# Copyright (c) 2019 Nordic Semiconductor ASA
# SPDX-License-Identifier: Apache-2.0

description: NXP DMIC

compatible: "nxp,mcux-dmic"

include: [base.yaml, pinctrl-device.yaml]

properties:
  reg:
    required: true

  interrupts:
    required: true

  pinctrl-0:
    required: true

  fifo-size:
    type: int
    default: 16
    description: |
      Size of the queue of received audio data blocks to be used
      by the driver.
```

## dts/bindings/audio/nxp,wm8960.yaml
```yaml
# Copyright (c) 2018, Intel Corporation
# SPDX-License-Identifier: Apache-2.0

description: Wolfson WM8960 Audio DAC

compatible: "nxp,wm8960"

include: i2c-device.yaml

properties:
    int-gpios:
      type: phandle-array
      required: true
```

## dts/bindings/audio/wolfson,wm8960.yaml
```yaml
# Copyright (c) 2021, NXP
# SPDX-License-Identifier: Apache-2.0

description: WM8960 audio codec

compatible: "wolfson,wm8960"

include: i2c-device.yaml
```

## dts/bindings/clock/nxp,imx-anatop.yaml
```yaml
# Copyright (c) 2017, NXP
# SPDX-License-Identifier: Apache-2.0

description: i.MX ANATOP (Analog Clock Controller Module) IP node

compatible: "nxp,imx-anatop"

include: [clock-controller.yaml, base.yaml]

properties:
    reg:
      required: true

    label:
      required: true

    "#clock-cells":
      type: int
      const: 4
      required: true
      description: Number of items to expect in a clock specifier

    "#pll_clock-cells":
      type: int
      const: 4
      required: true
      description: Number of items to expect in a PLL specifier   

clock-cells:
  - name
  - offset
  - bits
  - value

pll_clock-cells:
  - name
  - offset
  - bits
  - value
```

## dts/bindings/i2s/nxp,mcux-i2s.yaml
```yaml
# Copyright (c) 2021, NXP
# SPDX-License-Identifier: Apache-2.0

description: NXP mcux SAI-I2S controller

compatible: "nxp,mcux-i2s"

include: [i2s-controller.yaml]

properties:
    reg:
      required: true

    interrupts:
      required: true

    dma-names:
      required: true

    nxp,tx-dma-channel:
      type: int
      required: true
      description: tx dma channel number

    nxp,rx-dma-channel:
      type: int
      required: true
      description: rx dma channel number

    nxp,tx-sync-mode:
      type: int
      required: false
      description: tx sync mode

    nxp,rx-sync-mode:
      type: int
      required: false
      description: rx sync mode

    pll-clocks:
      type: phandle-array
      required: true
      description: pll settings

    pinmuxs:
      type: phandle-array
      required: true
      description: iomux settings
```

## dts/bindings/i2s/nxp,rt-i2s.yaml
```yaml
# Copyright (c) 2020, NXP
# SPDX-License-Identifier: Apache-2.0

description: NXP RT SAI-I2S controller

compatible: "nxp,rt-i2s"

include: [i2s-controller.yaml, dma.yaml]

properties:
    reg:
      required: true

    interrupts:
      required: true

    dma-names:
      required: true

    iomuxs:
      type: phandle-array
      required: true

    "#iomux-cells":
      type: int
      const: 3
      required: true
      description: Number of items to expect in a iomux specifier

iomux-cells:
  - offset
  - mask  
```

## dts/bindings/iio/adc/nxp,kinetis-adc16.yaml
```yaml
# Copyright (c) 2017, NXP
# SPDX-License-Identifier: Apache-2.0

description: Kinetis ADC16

compatible: "nxp,kinetis-adc16"

include: adc-controller.yaml

properties:
    reg:
      required: true

    interrupts:
      required: true 

    "#io-channel-cells":
      const: 1

    clk_source:
      type: int
      required: false
      description: use alternate clock reference source

    long_sample:
      type: int
      required: false
      description: enable long sample mode

    nxp,continues_convert:
      type: boolean
      required: false
      description: If use continues convert

    nxp,high_speed:
      type: boolean
      required: false
      description: If use high speed

io-channel-cells:
    - input
```

## dts/bindings/iomuxc/iomux-controller.yaml
```yaml
# Copyright (c) 2017, NXP
# SPDX-License-Identifier: Apache-2.0

# Common fields for IOMUX controllers

properties:
    "#iomux-cells":
      type: int
      required: true
      description: Number of items to expect in a GPIO specifier
```

## dts/bindings/iomuxc/nxp,imx-iomuxc.yaml
```yaml
# Copyright (c) 2017, NXP
# SPDX-License-Identifier: Apache-2.0

description: i.MX IOMUXC node

compatible: "nxp,imx-iomuxc"

include: [iomux-controller.yaml, base.yaml]

properties:
    reg:
      required: true

    label:
      required: true

    "#iomux-cells":
      const: 2

iomux-cells:
  - offset
  - mask
```

## modules/Kconfig.tensflow
```kconfig
# Cryptography primitive options for TENSFLOW

# Copyright (c) 2021 Intel Corporation
# SPDX-License-Identifier: Apache-2.0

menuconfig TENSFLOW
	bool "TENSFLOW Support"
	help
	  This option enables the TENSFLOW library.

menuconfig TENSFLOW_LITE
	bool "TENSFLOW LITE Support"
	help
	  This option enables the TENSFLOW library.

menuconfig TENSFLOW_LITE_MICRO
	bool "TENSFLOW LITE MICRO Support"
	help
	  This option enables the TENSFLOW library.
```

## samples/drivers/audio/dmic/boards/mimxrt595_evk_cm33.conf
```kconfig
#
# Copyright (c) 2023, NXP
#
# SPDX-License-Identifier: Apache-2.0
#

CONFIG_DMA=y
CONFIG_I2S_MCUX_FLEXCOMM=y
CONFIG_I3C=y
CONFIG_HEAP_MEM_POOL_SIZE=1024
CONFIG_AUDIO=y
CONFIG_AUDIO_CODEC=y
CONFIG_AUDIO_CODEC_WM8904=y
```

## samples/drivers/audio/dmic_i2s_codec/sample.yaml
```yaml
sample:
  name: DMIC sample
tests:
  sample.drivers.audio.dmic:
    tags: dmic
    filter: dt_nodelabel_enabled("dmic_dev")
    integration_platforms:
      - mimxrt595_evk_cm33
```

## samples/net/gptp/boards/mimxrt1050_evk.conf
```kconfig
CONFIG_ETH_MCUX=y
CONFIG_PTP_CLOCK_MCUX=y
CONFIG_NET_CONFIG_MY_IPV6_ADDR="2001:db8::2"
CONFIG_NET_CONFIG_PEER_IPV6_ADDR="2001:db8::1"
CONFIG_NET_CONFIG_MY_IPV4_ADDR="192.0.2.2"
CONFIG_NET_CONFIG_PEER_IPV4_ADDR="192.0.2.1"
CONFIG_ETH_MCUX_PTP_CLOCK_SRC_HZ=25000000
```

## samples/net/gptp/boards/mimxrt1060_evk.conf
```kconfig
CONFIG_ETH_MCUX=y
CONFIG_PTP_CLOCK_MCUX=y
CONFIG_ETH_MCUX_PTP_CLOCK_SRC_HZ=25000000
CONFIG_NET_GPTP_NEIGHBOR_PROP_DELAY_THR=1000000
CONFIG_NET_GPTP_PROBE_CLOCK_SOURCE_ON_DEMAND=y
CONFIG_NET_GPTP_CLOCK_ACCURACY_25MS=y
#CONFIG_ETH_MCUX_RX_BUFFERS=1
#CONFIG_ETH_MCUX_TX_BUFFERS=8
```

## subsys/audio/Kconfig
```kconfig
# Audio configuration options

# Copyright (c) 2020 NXP Semiconductor INC.
# SPDX-License-Identifier: Apache-2.0

menuconfig SOC_AUDIO
	bool "SOC Audio"
	default n
	help
	  This option enables Audio Framework support.

if SOC_AUDIO

module = SOC_AUDIO
module-str = soc_audio
source "subsys/logging/Kconfig.template.log_config"

source "subsys/audio/common/Kconfig"

source "subsys/audio/machine/Kconfig"

endif # SOC_AUDIO
```
