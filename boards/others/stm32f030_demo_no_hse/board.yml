## boards/others/stm32f030_demo_no_hse/board.yml
```yaml
board:
  name: stm32f030_demo_no_hse
  full_name: STM32F030 DEMO BOARD (HSI clock, no HSE crystal)
  vendor: others
  socs:
    - name: stm32f030x6
```

## drivers/adc/Kconfig.ads1256
```kconfig
# SPDX-License-Identifier: Apache-2.0

config ADC_ADS1256
	bool "Texas Instruments ADS1256 ADC driver"
	depends on SPI
	select ADC_CONFIGURABLE_INPUTS
	select ADC_ASYNC
	help
		Enable driver for Texas Instruments ADS1256
		8-channel 24-bit SPI ADC.

if ADC_ADS1256

config ADC_ADS1256_INIT_PRIORITY
	int "ADS1256 ADC driver initialization priority"
	default 80
	range 0 99
	help
		ADS1256 ADC device driver initialization priority.

endif # ADC_ADS1256
```

## drivers/audio/Kconfig.wm8900
```kconfig
# Copyright 2024 NXP
# SPDX-License-Identifier: Apache-2.0

config AUDIO_CODEC_WM8900
	bool "Wolfson WM8900 Audio Codec"
	depends on I2C
	help
		Enable Wolfson WM8900 audio codec driver.

		This driver supports the WM8900 stereo audio codec with headphone
		and line outputs, and microphone inputs.

if AUDIO_CODEC_WM8900

config WM8900_INIT_PRIORITY
	int "WM8900 initialization priority"
	default 70
	range 0 99
	help
		Initialization priority for WM8900 audio codec driver.

config WM8900_I2C_ADDRESS
	hex "WM8900 I2C address"
	default 0x1A
	range 0x1A 0x1B
	help
		I2C address for the WM8900 audio codec.

		The WM8900 supports two I2C addresses:
		- 0x1A when ADDR pin is low
		- 0x1B when ADDR pin is high

config WM8900_CLOCK_SOURCE
	int "WM8900 clock source"
	default 0
	help
		Clock source selection for WM8900.

		0: MCLK
		1: PLL

endif # AUDIO_CODEC_WM8900
```

## drivers/audio/Kconfig.wm8900_emul
```kconfig
# Copyright 2025 NXP
# SPDX-License-Identifier: Apache-2.0

config AUDIO_CODEC_WM8900_EMUL
	bool "Wolfson WM8900 Audio Codec Emulator"
	default y
	depends on DT_HAS_WOLFSON_WM8900_EMUL_ENABLED
	depends on EMUL
	select I2C_EMUL
	help
		Enable Wolfson WM8900 audio codec emulator.

		This emulator provides a virtual WM8900 audio codec for testing
		purposes on native_posix and other emulation platforms.

if AUDIO_CODEC_WM8900_EMUL

config WM8900_EMUL_LOG_LEVEL
	int "WM8900 emulator log level"
	default 2
	range 0 4
	help
		Set log level for WM8900 emulator.

		Levels are:
		- 0 OFF
		- 1 ERROR
		- 2 WARNING
		- 3 INFO
		- 4 DEBUG

endif # AUDIO_CODEC_WM8900_EMUL
```

## dts/bindings/adc/ti,ads1256.yaml
```yaml
# Copyright (c) 2024 The Zephyr Project Contributors
# SPDX-License-Identifier: Apache-2.0

description: TI ADS1256 8-channel, 24-bit SPI ADC
compatible: "ti,ads1256"

include:
  - adc-controller.yaml
  - spi-device.yaml

properties:
  "#io-channel-cells":
    const: 1

  drdy-gpios:
    type: phandle-array
    required: true
    description: |
      GPIO for data ready, becomes active when a conversion result is ready.
      Typically active low signal.

  reset-gpios:
    type: phandle-array
    description: |
      Optional GPIO for hardware reset control.

  sync-gpios:
    type: phandle-array
    description: |
      Optional GPIO for synchronization control.
      Used to synchronize conversions across multiple ADCs.

  data-rate:
    type: string
    description: |
      Data rate selection:
      - "ADS1256_DRATE_30000"  # 30,000 SPS
      - "ADS1256_DRATE_15000"  # 15,000 SPS
      - "ADS1256_DRATE_10000"  # 10,000 SPS
      - "ADS1256_DRATE_5000"   # 5,000 SPS
      - "ADS1256_DRATE_1000"   # 1,000 SPS
      - "ADS1256_DRATE_100"    # 100 SPS
      - "ADS1256_DRATE_60"     # 60 SPS
      - "ADS1256_DRATE_50"     # 50 SPS
    enum:
      - "ADS1256_DRATE_30000"  # 30,000 SPS
      - "ADS1256_DRATE_15000"  # 15,000 SPS
      - "ADS1256_DRATE_10000"  # 10,000 SPS
      - "ADS1256_DRATE_5000"   # 5,000 SPS
      - "ADS1256_DRATE_1000"   # 1,000 SPS
      - "ADS1256_DRATE_100"    # 100 SPS
      - "ADS1256_DRATE_60"     # 60 SPS
      - "ADS1256_DRATE_50"     # 50 SPS

  standby-on-boot:
    type: boolean
    description: Enter standby mode immediately after initialization

  sensor-current:
      type: int
      enum:
        - 0
        - 500
        - 2000
        - 10000
      default: 0
      description: |
        sensor current in nanoampere, the default value turns the current source off

io-channel-cells:
  - input
```

## dts/bindings/audio/wolfson,wm8900.yaml
```yaml
# Copyright 2024 NXP
# SPDX-License-Identifier: Apache-2.0

description: WM8900 audio codec

include: [i2c-device.yaml]

compatible: "wolfson,wm8900"

properties:
  reg:
    required: true
  clock-source:
    type: string
    default: "MCLK"
    description: |
      Codec's internal clock signal (SYSCLK) source selection. These options
      are available:
      - "MCLK": WM8900's MCLK pin (supplied by the host)
      - "FLL":  WM8900's FLL facility, can be free-running
      The "MCLK" option is default, as this clock signal is usually supplied
      by the host.
    enum:
      - "MCLK"
      - "FLL"

  clocks:
    type: phandle-array
    required: true
    description: |
      Phandle to the clock provider and a clock specifier for the MCLK input.

  clock-names:
    type: string
    required: true
    description: |
      Must be "mclk".

  #interrupts:
  #  type: phandle-array
  #  description: |
  #    Optional interrupt line for codec events.

  #reset-gpios:
  #  type: phandle-array
  #  description: |
  #    Optional GPIO line for hardware reset.

required:
  - reg
  - clocks
  - clock-names
```

## samples/drivers/adc/adc_power_measure/Kconfig
```kconfig
# Copyright (c) 2024 Centro de Inovacao EDGE.
# SPDX-License-Identifier: Apache-2.0

config SEQUENCE_SAMPLES
	int "Number of samples to be made on the sequence for each channel."
	default 5

config SEQUENCE_DISCARD_FIRST
	bool "Discard the first sample of every channel before averaging"
	default y
	help
	  The first reading after a channel switch is taken while the
	  sample-and-hold capacitor is still settling, so it reads noticeably
	  lower than the following ones.  Discard it before averaging whenever
	  the sequence provides more than one sample per channel.

config SEQUENCE_RESOLUTION
	int "Set the resolution of the sequence readings."
	default 12

config SEQUENCE_32BITS_REGISTERS
	bool "ADC data sequences are on 32bits"

config SHELL_ADC_PS
	bool "ADC power shield shell"

source "Kconfig.zephyr"
```

## samples/drivers/adc/adc_power_measure/boards/stm32f030_demo.conf
```kconfig
# The A4114 power shield driver can only acquire one sequence sample; that
# restriction does not apply to stm32f030_demo, where 5 samples per channel
# were verified on hardware.
CONFIG_SEQUENCE_SAMPLES=5
CONFIG_SEQUENCE_RESOLUTION=12
# CONFIG_SEQUENCE_32BITS_REGISTERS is not set
#CONFIG_SCHED_SIMPLE=y
#CONFIG_WAITQ_SIMPLE=y
#CONFIG_ARM_MPU=n
CONFIG_GEN_SW_ISR_TABLE=y
#CONFIG_GEN_ISR_TABLES=n
CONFIG_CBPRINTF_NANO=y
CONFIG_CBPRINTF_FP_SUPPORT=n
CONFIG_CBPRINTF_FULL_INTEGRAL=n

# Memory constraints
CONFIG_MAIN_STACK_SIZE=512
CONFIG_IDLE_STACK_SIZE=256
CONFIG_ISR_STACK_SIZE=512
CONFIG_HEAP_MEM_POOL_SIZE=0

# ADC minimal
CONFIG_ADC_ASYNC=n
CONFIG_ADC_SHELL=n

CONFIG_SIZE_OPTIMIZATIONS=y
CONFIG_NO_OPTIMIZATIONS=n

CONFIG_PM=n
CONFIG_BOOT_BANNER=n
CONFIG_BOOT_DELAY=0

CONFIG_DEBUG=n
CONFIG_DEBUG_OPTIMIZATIONS=n
CONFIG_ASSERT=n

CONFIG_LOG=y
CONFIG_LOG_DEFAULT_LEVEL=0
CONFIG_LOG_MAX_LEVEL=0
CONFIG_LOG_PRINTK=n
CONFIG_LOG_MODE_MINIMAL=y
CONFIG_LOG_BUFFER_SIZE=64

CONFIG_DYNAMIC_INTERRUPTS=n
CONFIG_LTO=y
CONFIG_ISR_TABLES_LOCAL_DECLARATION=y

#CONFIG_KERNEL_BIN_NAME="a"

CONFIG_PICOLIBC=y
CONFIG_PICOLIBC_IO_FLOAT=n
CONFIG_PICOLIBC_IO_LONG_LONG=n
```

## subsys/net/ip/Kconfig.ndp
```kconfig
# NDP (Network Data Plane) options

# Copyright (c) 2026 NDP Developer
# SPDX-License-Identifier: Apache-2.0

menuconfig NDP_PACKET_PROCESSING
	bool "NDP Packet Processing"
	depends on NET_IP
	help
	  Enable Network Data Plane callback system for packet processing.

if NDP_PACKET_PROCESSING

module = NDP
module-dep = NET_LOG
module-str = Log level for NDP
module-help = Enables NDP output debug messages
source "subsys/net/Kconfig.template.log_config.net"

config NDP_ONLY_MODE
	bool "NDP-only mode"
	default n
	help
	  If enabled, packets processed by NDP callbacks will bypass native network stack.

endif # NDP_PACKET_PROCESSING
```

## tests/drivers/audio/wm8900/testcase.yaml
```yaml
tests:
  drivers.audio.wm8900:
    tags: audio codec i2c
    filter: CONFIG_AUDIO_CODEC_WM8900
```
