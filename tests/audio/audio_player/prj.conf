## prj.conf
```kconfig
CONFIG_ZTEST=y
CONFIG_LOG=y
CONFIG_SOC_AUDIO=y
CONFIG_NXP_RT_AUDIO_SYS=y
CONFIG_I2S_IMX_RT=y
CONFIG_AUDIO_WM8960=y
CONFIG_AUDIO_PM=y
```

## src/main.c
```c
/* test audio play back*/

/*
 * Copyright (c) 2020 NXP Semiconductor INC.
 * All rights reserved.
 *
 * SPDX-License-Identifier: Apache-2.0
 */



#include <ztest.h>
#include <kernel_internal.h>


/**
 *
 * @brief Regression test's entry point
 *
 *
 * @return N/A
 */

void test_sin_wav(void)
{

}


void test_main(void)
{
	ztest_test_suite(common_test, ztest_unit_test(test_sin_wav));

	ztest_run_test_suite(common_test);
}
```
