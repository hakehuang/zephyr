## CMakeLists.txt
```
# SPDX-License-Identifier: Apache-2.0

cmake_minimum_required(VERSION 3.20.0)

find_package(Zephyr REQUIRED HINTS $ENV{ZEPHYR_BASE})
project(ndp_test)

target_sources(testbinary PRIVATE src/main.c)
```

## prj.conf
```kconfig
# NDP Test Configuration

# Enable networking
CONFIG_NETWORKING=y
CONFIG_NET_IPV4=y
CONFIG_NET_IPV6=y

# Enable Ethernet
CONFIG_NET_L2_ETHERNET=y

# Enable NDP packet processing
CONFIG_NDP_PACKET_PROCESSING=y

# Testing
CONFIG_ZTEST=y
CONFIG_ZTEST_NEW_API=y

# Logging
CONFIG_LOG=y
CONFIG_TEST_LOGGING_DEFAULTS=n

# Network buffers
CONFIG_NET_BUF=y
CONFIG_NET_PKT_RX_COUNT=8
CONFIG_NET_PKT_TX_COUNT=8

# Main stack size
CONFIG_MAIN_STACK_SIZE=2048
```

## src/main.c
```c
/*
 * Copyright NDP Developer 2026
 *
 * SPDX-License-Identifier: Apache-2.0
 */

#include <zephyr/ztest.h>
#include <zephyr/net/net_if.h>
#include <zephyr/net/net_pkt.h>
#include <zephyr/net/net_ndp.h>

static struct net_if *test_iface;

/**
 * @brief Test callback function
 */
static enum net_verdict test_callback(struct net_pkt *pkt)
{
    ARG_UNUSED(pkt);
    return NET_OK;
}

/**
 * @brief Test NDP callback registration
 */
ZTEST(ndp_test, test_ndp_register_callback)
{
    int ret;
    
    zassert_not_null(test_iface, "Network interface required");
    
    ret = net_ndp_register_callback(test_iface, test_callback);
    zassert_true(ret >= 0, "NDP registration should succeed");
    
    /* Clean up */
    ret = net_ndp_unregister_callback(test_iface, test_callback);
    zassert_true(ret >= 0, "NDP unregistration should succeed");
}

/**
 * @brief Test NDP callback with null parameters
 */
ZTEST(ndp_test, test_ndp_null_parameters)
{
    int ret;
    
    /* Test null interface */
    ret = net_ndp_register_callback(NULL, test_callback);
    zassert_true(ret < 0, "Should fail with null interface");
    
    /* Test null callback */
    ret = net_ndp_register_callback(test_iface, NULL);
    zassert_true(ret < 0, "Should fail with null callback");
}

/**
 * @brief Setup function for tests
 */
static void *ndp_setup(void)
{
    test_iface = net_if_get_default();
    return NULL;
}

ZTEST_SUITE(ndp_test, NULL, ndp_setup, NULL, NULL, NULL);
```
